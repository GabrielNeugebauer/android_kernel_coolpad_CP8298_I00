## arch/arm64/Kconfig.debug
```kconfig
menu "Kernel hacking"

source "lib/Kconfig.debug"

config FRAME_POINTER
	bool
	default y

config STRICT_DEVMEM
	bool "Filter access to /dev/mem"
	depends on MMU
	help
	  If this option is disabled, you allow userspace (root) access to all
	  of memory, including kernel and userspace memory. Accidental
	  access to this is obviously disastrous, but specific access can
	  be used by people debugging the kernel.

	  If this option is switched on, the /dev/mem file only allows
	  userspace access to memory mapped peripherals.

	  If in doubt, say Y.

config PID_IN_CONTEXTIDR
	bool "Write the current PID to the CONTEXTIDR register"
	help
	  Enabling this option causes the kernel to write the current PID to
	  the CONTEXTIDR register, at the expense of some additional
	  instructions during context switch. Say Y here only if you are
	  planning to use hardware trace tools with this kernel.

config ARM64_RANDOMIZE_TEXT_OFFSET
	bool "Randomize TEXT_OFFSET at build time"
	help
	  Say Y here if you want the image load offset (AKA TEXT_OFFSET)
	  of the kernel to be randomized at build-time. When selected,
	  this option will cause TEXT_OFFSET to be randomized upon any
	  build of the kernel, and the offset will be reflected in the
	  text_offset field of the resulting Image. This can be used to
	  fuzz-test bootloaders which respect text_offset.

	  This option is intended for bootloader and/or kernel testing
	  only. Bootloaders must make no assumptions regarding the value
	  of TEXT_OFFSET and platforms must not require a specific
	  value.

config DEBUG_SET_MODULE_RONX
        bool "Set loadable kernel module data as NX and text as RO"
        depends on MODULES
        help
          This option helps catch unintended modifications to loadable
          kernel module's text and read-only data. It also prevents execution
          of module data. Such protection may interfere with run-time code
          patching and dynamic kernel tracing - and they might also protect
          against certain classes of kernel exploits.
          If in doubt, say "N".

config ME1DS_BOOT_STRIPES
	bool "Paint boot-progress stripes on the LG K130 framebuffer"
	select FONT_SUPPORT
	help
	  Debug aid for the LG K130 (me1ds), which has no serial console.
	  Boot stages paint white stripes into the framebuffer lk left on
	  the video-mode panel; each finished initcall level adds a black
	  notch at the left of its stripe. Kernel messages (with
	  initcall_debug on) are also drawn as text, wrapping from the top.

endmenu
```

## drivers/misc/mediatek/base/power/Kconfig
```kconfig
config MTK_CLKMGR
	bool "Mediatek proprietary clock management"
	default n
	---help---
	  Mediatek proprietary clock management is used to operate
          the clocks. The clocks are composed of CG, MUX, PLL,
          non-MTCMOS. The operations of clocks are enabling,
          disabling, and querying status. If this config is not set,
          system will use COMMON_CLK instead.

config MTK_DISABLE_SODI
	bool "Disable SODI"
	default n
	---help---
	  Select if you want to disable Screen ON DeepIdle (SODI).


config ME1DS_CPU_OC
	bool "LG K130: 1092MHz CPU OPP"
	depends on ARCH_MT6735M
	default n
	help
	  Adds the MT6735M+ 1092MHz bin (1.25V) to the 1GHz CPU table, the
	  highest ARMPLL setting this part accepts. The CPU boots capped at
	  988MHz; raise scaling_max_freq to use it. PTP-OD voltages apply
	  only up to 988MHz.
```

## drivers/misc/mediatek/leds/Kconfig
```kconfig
config MTK_LEDS
	tristate "MediaTek LED Support"
	depends on LEDS_CLASS
	---help---
	  This selects the MediaTek(R) LEDs connected to MediaTek chips.
	  If you want to use MediaTek(R) LEDs support, say Y or M here.
	  If unsure, say N.
	  Mediatek LED module includes backlight, indicate LED, keypad LED, button LED etc.

config LIGHTNESS_MAPPING_VALUE
	int "LIGHTNESS_MAPPING_VALUE"
	default 255
 	---help---
	  Backlight brightness mapping value, from 0 to 255.

config TB8173_EVB
	bool "Support TB8173 EVB board"
config LEDS_RT8542
	bool "RT8542 backlight charge pump (LG K130)"
	depends on MTK_LEDS && I2C
	help
	  Drives the LCD backlight through the RT8542 on I2C. Select the
	  backlight with led_mode = <4> (CUST_LCM) in the device tree.
```
